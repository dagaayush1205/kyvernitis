## drivers/sensor/wheel_encoders_stm32/Kconfig
```kconfig
config QDEC_DIST_STM32
	bool "STM32 QDEC driver"
	default y
	depends on DT_HAS_ST_STM32_QDEC_ENABLED
	select USE_STM32_LL_TIM
	help
	  STM32 family Quadrature Decoder driver.
```

## dts/bindings/st,stm32-qdec-distance.yaml
```yaml
description: STM32 quadrature decoder

compatible: "st,stm32-qdec-distance"

include:
  - name: st,stm32-qdec.yaml
```
